## conf/bblayers.conf
```bitbake
# POKY_BBLAYERS_CONF_VERSION is increased each time build/conf/bblayers.conf
# changes incompatibly
POKY_BBLAYERS_CONF_VERSION = "2"

BBPATH = "${TOPDIR}"
BBFILES ?= ""

BBLAYERS ?= " \
  ${PWD}/sources/poky-dunfell/meta \
  ${PWD}/sources/poky-dunfell/meta-poky \
  ${PWD}/sources/poky-dunfell/meta-yocto-bsp \
  ${PWD}/sources/meta-raspberrypi \
  ${PWD}/sources/meta-openembedded/meta-oe \
  ${PWD}/sources/meta-openembedded/meta-multimedia \
  ${PWD}/sources/meta-openembedded/meta-networking \
  ${PWD}/sources/meta-openembedded/meta-python \
  "
```
